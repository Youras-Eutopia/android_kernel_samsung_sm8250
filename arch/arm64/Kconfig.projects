## arch/arm64/Kconfig.projects
```kconfig
menu "Project selection"

config SEC_X1Q_PROJECT
	depends on ARCH_KONA
	default n
	bool "Samsung X1Q Project"
	help
	  Support for Samsung X1Q Project

config MACH_X1Q_KOR_SINGLE
	depends on SEC_X1Q_PROJECT
	default n
	bool "Samsung X1Q KOR SQ"
	help
	  Support for Samsung X1Q KOR SQ device.

config MACH_X1Q_USA_SINGLE
	depends on SEC_X1Q_PROJECT
	default n
	bool "Samsung X1Q USA SQ"
	help
	  Support for Samsung X1Q USA SQ device.

config MACH_X1Q_CAN_SINGLE
	depends on SEC_X1Q_PROJECT
	select MACH_X1Q_USA_SINGLE
	default n
	bool "Samsung X1Q CAN SQ"
	help
	  Support for Samsung X1Q CAN SQ device.

config MACH_X1Q_CHN_OPEN
	depends on SEC_X1Q_PROJECT
	default n
	bool "Samsung X1Q CHN OPEN"
	help
	  Support for Samsung X1Q CHN OPEN device.

config MACH_X1Q_CHN_HKX
	select MACH_X1Q_CHN_OPEN
	default n
	bool "Samsung X1Q CHN HKX"
	help
	  Support for Samsung X1Q CHN HKX device.

config MACH_X1Q_JPN_SINGLE
	depends on SEC_X1Q_PROJECT
	default n
	bool "Samsung X1Q JPN SINGLE"
	help
	  Support for Samsung X1Q JPN SINGLE device.

config SEC_Y2Q_PROJECT
	depends on ARCH_KONA
	default n
	bool "Samsung Y2Q Project"
	help
	  Support for Samsung Y2Q Project

config MACH_Y2Q_KOR_SINGLE
	depends on SEC_Y2Q_PROJECT
	default n
	bool "Samsung Y2Q KOR SQ"
	help
	  Support for Samsung Y2Q KOR SQ device.

config MACH_Y2Q_USA_SINGLE
	depends on SEC_Y2Q_PROJECT
	default n
	bool "Samsung Y2Q USA SQ"
	help
	  Support for Samsung Y2Q USA SQ device.

config MACH_Y2Q_CAN_SINGLE
	depends on SEC_Y2Q_PROJECT
	select MACH_Y2Q_USA_SINGLE
	default n
	bool "Samsung Y2Q CAN SQ"
	help
	  Support for Samsung Y2Q CAN SQ device.

config MACH_Y2Q_CHN_OPEN
	depends on SEC_Y2Q_PROJECT
	default n
	bool "Samsung Y2Q CHN OPEN"
	help
	  Support for Samsung Y2Q CHN OPEN device.

config MACH_Y2Q_CHN_HKX
	select MACH_Y2Q_CHN_OPEN
	default n
	bool "Samsung Y2Q CHN HKX"
	help
	  Support for Samsung Y2Q CHN HKX device.

config MACH_Y2Q_JPN_SINGLE
	depends on SEC_Y2Q_PROJECT
	default n
	bool "Samsung Y2Q JPN SINGLE"
	help
	  Support for Samsung Y2Q JPN SINGLE device.

config MACH_Y2Q_JPN_DCMOLY
	depends on SEC_Y2Q_PROJECT
	default n
	bool "Samsung Y2Q JPN OLY DCMOLY"
	help
	  Support for Samsung Y2Q JPN DCMOLY device.

config SEC_Z3Q_PROJECT
	depends on ARCH_KONA
	default n
	bool "Samsung Z3Q Project"
	help
	  Support for Samsung Z3Q Project

config MACH_Z3Q_KOR_SINGLE
	depends on SEC_Z3Q_PROJECT
	default n
	bool "Samsung Z3Q KOR SQ"
	help
	  Support for Samsung Z3Q KOR SQ device.

config MACH_Z3Q_USA_SINGLE
	depends on SEC_Z3Q_PROJECT
	default n
	bool "Samsung Z3Q USA SQ"
	help
	  Support for Samsung Z3Q USA SQ device.

config MACH_Z3Q_CAN_SINGLE
	depends on SEC_Z3Q_PROJECT
	select MACH_Z3Q_USA_SINGLE
	default n
	bool "Samsung Z3Q CAN SQ"
	help
	  Support for Samsung Z3Q CAN SQ device.

config MACH_Z3Q_CHN_OPEN
	depends on SEC_Z3Q_PROJECT
	default n
	bool "Samsung Z3Q CHN OPEN"
	help
	  Support for Samsung Z3Q CHN OPEN device.

config MACH_Z3Q_CHN_HKX
	select MACH_Z3Q_CHN_OPEN
	default n
	bool "Samsung Z3Q CHN HKX"
	help
	  Support for Samsung Z3Q CHN HKX device.

config MACH_Z3Q_JPN_SINGLE
	depends on SEC_Z3Q_PROJECT
	default n
	bool "Samsung Z3Q JPN SINGLE"
	help
	  Support for Samsung Z3Q JPN SINGLE device.

config SEC_C1Q_PROJECT
	depends on ARCH_KONA
	default n
	bool "Samsung C1Q Project"
	help
	  Support for Samsung C1Q Project

config MACH_C1Q_USA_SINGLE
	default n
	bool "Samsung C1Q USA SQ"
	help
	  Support for Samsung C1Q USA SQ device.

config MACH_C1Q_CAN_SINGLE
	select MACH_C1Q_USA_SINGLE
	default n
	bool "Samsung C1Q CAN SQ"
	help
	  Support for Samsung C1Q CAN SQ device.

config MACH_C1Q_KOR_SINGLE
	default n
	bool "Samsung C1Q KOR SQ"
	help
	  Support for Samsung C1Q KOR SQ device.

config MACH_C1Q_CHN_OPEN
	default n
	bool "Samsung C1Q CHN OPEN"
	help
	  Support for Samsung C1Q CHN OPEN device.

config MACH_C1Q_CHN_HK
	select MACH_C1Q_CHN_OPEN
	default n
	bool "Samsung C1Q CHN HK"
	help
	  Support for Samsung C1Q CHN HK device.

config SEC_C2Q_PROJECT
	depends on ARCH_KONA
	default n
	bool "Samsung C2Q Project"
	help
	  Support for Samsung C2Q Project

config MACH_C2Q_USA_SINGLE
	default n
	bool "Samsung C2Q USA SQ"
	help
	  Support for Samsung C2Q USA SQ device.

config MACH_C2Q_KOR_SINGLE
	default n
	bool "Samsung C2Q KOR SQ"
	help
	  Support for Samsung C2Q KOR SQ device.

config MACH_C2Q_CAN_SINGLE
        select MACH_C2Q_USA_SINGLE
	default n
	bool "Samsung C2Q CAN SQ"
	help
	  Support for Samsung C2Q CAN SQ device.

config MACH_C2Q_JPN_SINGLE
	default n
	bool "Samsung C2Q JPN SQ"
	help
	  Support for Samsung C2Q JPN SQ device.

config MACH_C2Q_CHN_OPEN
	default n
	bool "Samsung C2Q CHN OPEN"
	help
	  Support for Samsung C2Q CHN OPEN device.

config MACH_C2Q_CHN_HK
	select MACH_C2Q_CHN_OPEN
	default n
	bool "Samsung C2Q CHN HK"
	help
	  Support for Samsung C2Q CHN HK device.

config SEC_GTS7XL_PROJECT
	depends on ARCH_KONA
	default n
	bool "Samsung GTS7XL Project"
	help
	  Support for Samsung GTS7XL Project

config SEC_GTS7L_PROJECT
	depends on ARCH_KONA
	default n
	bool "Samsung GTS7L Project"
	help
	  Support for Samsung GTS7L Project

config MACH_GTS7XL_EUR_OPEN
	default n
	bool "Samsung GTS7XL EUR OPEN"
	help
	  Support for Samsung GTS7XL EUR OPEN device.

config MACH_GTS7XLWIFI_EUR_OPEN
	default n
	bool "Samsung GTS7XLWIFI EUR OPEN"
	help
	  Support for Samsung GTS7XLWIFI EUR OPEN device.

config MACH_GTS7XL_KOR_OPEN
	default n
	bool "Samsung GTS7XL KOR OPEN"
	help
	  Support for Samsung GTS7XL KOR OPEN device.

config MACH_GTS7XL_USA_SINGLE
	default n
	bool "Samsung GTS7XL USA SINGLE"
	help
	  Support for Samsung GTS7XL USA SINGLE device.

config MACH_GTS7L_EUR_OPEN
	default n
	bool "Samsung GTS7L EUR OPEN"
	help
	  Support for Samsung GTS7L EUR OPEN device.

config MACH_GTS7LWIFI_EUR_OPEN
	default n
	bool "Samsung GTS7LWIFI EUR OPEN"
	help
	  Support for Samsung GTS7LWIFI EUR OPEN device.

config MACH_GTS7L_KOR_OPEN
	default n
	bool "Samsung GTS7L KOR OPEN"
	help
	  Support for Samsung GTS7L KOR OPEN device.

config MACH_GTS7L_USA_SINGLE
	default n
	bool "Samsung GTS7L USA SINGLE"
	help
	  Support for Samsung GTS7L USA SINGLE device.

config SEC_R8Q_PROJECT
	depends on ARCH_KONA
	default n
	bool "Samsung R8Q Project"
	help
	  Support for Samsung R8Q Project

config MACH_R8Q_USA_SINGLE
	depends on SEC_R8Q_PROJECT
	default n
	bool "Samsung R8Q USA SQ"
	help
	  Support for Samsung R8Q USA SQ device.

config MACH_R8Q_CAN_SINGLE
	depends on SEC_R8Q_PROJECT
	select MACH_R8Q_USA_SINGLE
	default n
	bool "Samsung R8Q CAN SINGLE"
	help
	  Support for Samsung R8Q CAN SINGLE device.

config MACH_R8Q_EUR_OPEN
	depends on SEC_R8Q_PROJECT
	default n
	bool "Samsung R8Q EUR OPEN"
	help
	  Support for Samsung R8Q EUR OPEN device.

config MACH_R8Q_KOR_SINGLE
	depends on SEC_R8Q_PROJECT
	default n
	bool "Samsung R8Q KOR SINGLE"
	help
	  Support for Samsung R8Q KOR SINGLE device.

config MACH_R8Q_CHN_OPEN
	depends on SEC_R8Q_PROJECT
	default n
	bool "Samsung R8Q CHN OPEN"
	help
	  Support for Samsung R8Q CHN OPEN device.

config MACH_R8Q_CHN_HKX
	depends on SEC_R8Q_PROJECT
	select MACH_R8Q_CHN_OPEN
	default n
	bool "Samsung R8Q CHN HKX"
	help
	  Support for Samsung R8Q CHN HKX device.

endmenu
```
